## config/boards/shields/trackpad_xiao/Kconfig.defconfig
```kconfig
if SHIELD_TRACKPAD_XIAO

config ZMK_KEYBOARD_NAME
    default "Trackpad Xiao"

config ZMK_MOUSE
    default y

config ZMK_BLE
    default y

endif
```
